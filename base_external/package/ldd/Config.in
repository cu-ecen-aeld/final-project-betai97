## base_external/package/ldd/Config.in
```kconfig
config BR2_PACKAGE_LDD
	bool "ldd"
	help
	  Package that supports building and installing the misc-modules and scull components into the root filesystem.
```
